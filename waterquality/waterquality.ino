#include <Water_Quality_inferencing.h>
#include <Adafruit_GFX.h>
#include <Adafruit_SSD1306.h>
#include <Wire.h>

// Define number of sensors
#define N_SENSORS 3  
#define STACK_SIZE 16384 // 16KB stack for inference task
#define SCREEN_WIDTH 128  // OLED display width
#define SCREEN_HEIGHT 64  // OLED display height
#define OLED_RESET -1
Adafruit_SSD1306 display(SCREEN_WIDTH, SCREEN_HEIGHT, &Wire, OLED_RESET);
// Sensor data storage
static float data[N_SENSORS];
// Function declarations
bool init_pH(void);
bool init_TDS(void);
bool init_Turbidity(void);
uint8_t poll_pH(void);
uint8_t poll_TDS(void);
uint8_t poll_Turbidity(void);
const unsigned char logo [] PROGMEM = {
	0x00, 0x00, 0x00, 0x00, 0x00, 0x00, 0x00, 0x00, 0x00, 0x00, 0x00, 0x00, 0x00, 0x00, 0x00, 0x00, 
	0x00, 0x00, 0x00, 0x00, 0x00, 0x00, 0x00, 0x00, 0x00, 0x00, 0x00, 0x00, 0x00, 0x00, 0x00, 0x00, 
	0x00, 0x00, 0x00, 0x00, 0x00, 0x00, 0x00, 0x00, 0x00, 0x00, 0x00, 0x00, 0x00, 0x00, 0x00, 0x00, 
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	0x00, 0x00, 0x00, 0x00, 0x00, 0x00, 0x00, 0x00, 0x00, 0x00, 0x00, 0x00, 0x00, 0x00, 0x00, 0x00
};
const unsigned char good [] PROGMEM = {
	0x00, 0x00, 0x00, 0x00, 0x00, 0x00, 0x00, 0x00, 0x00, 0x00, 0x00, 0x00, 0x00, 0x00, 0x00, 0x00, 
	0x00, 0x00, 0x00, 0x00, 0x00, 0x00, 0x00, 0x00, 0x00, 0x00, 0x00, 0x00, 0x00, 0x00, 0x00, 0x00, 
	0x00, 0x00, 0x00, 0x00, 0x00, 0x00, 0x00, 0x00, 0x00, 0x00, 0x00, 0x00, 0x00, 0x00, 0x00, 0x00, 
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	0x00, 0x00, 0x00, 0x00, 0x00, 0x00, 0x00, 0x00, 0x00, 0x00, 0x00, 0x00, 0x00, 0x00, 0x00, 0x00
};
const unsigned char bad [] PROGMEM = {
	0x00, 0x00, 0x00, 0x00, 0x00, 0x00, 0x00, 0x00, 0x00, 0x00, 0x00, 0x00, 0x00, 0x00, 0x00, 0x00, 
	0x00, 0x00, 0x00, 0x00, 0x00, 0x00, 0x00, 0x00, 0x00, 0x00, 0x00, 0x00, 0x00, 0x00, 0x00, 0x00, 
	0x00, 0x00, 0x00, 0x00, 0x00, 0x00, 0x00, 0x00, 0x00, 0x00, 0x00, 0x00, 0x00, 0x00, 0x00, 0x00, 
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	0x00, 0x00, 0x00, 0x00, 0x00, 0x00, 0x00, 0x00, 0x00, 0x00, 0x00, 0x00, 0x00, 0x00, 0x00, 0x00
};
const unsigned char no [] PROGMEM = {
	0x00, 0x00, 0x00, 0x00, 0x00, 0x00, 0x00, 0x00, 0x00, 0x00, 0x00, 0x00, 0x00, 0x00, 0x00, 0x00, 
	0x00, 0x00, 0x00, 0x00, 0x00, 0x00, 0x00, 0x00, 0x00, 0x00, 0x00, 0x00, 0x00, 0x00, 0x00, 0x00, 
	0x00, 0x00, 0x00, 0x00, 0x00, 0x00, 0x00, 0x00, 0x00, 0x00, 0x00, 0x00, 0x00, 0x00, 0x00, 0x00, 
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	0x00, 0x00, 0x00, 0x00, 0x00, 0x00, 0x00, 0x00, 0x00, 0x00, 0x00, 0x00, 0x00, 0x00, 0x00, 0x00
};

/** Structure to hold sensor details */
typedef struct {
    const char *name;
    float *value;
    uint8_t (*poll_sensor)(void);
    bool (*init_sensor)(void);
    int8_t status;
} eiSensors;

// Sensor array
eiSensors sensors[] = {
    {"pH", &data[0], &poll_pH, &init_pH, -1},
    {"TDS", &data[2], &poll_TDS, &init_TDS, -1},
    {"Turbidity", &data[1], &poll_Turbidity, &init_Turbidity, -1},
};

// Sensor initialization functions
bool init_pH() {
    return true;
}
bool init_TDS() {
    return true;
}
bool init_Turbidity() {
    return true;
}

// Polling functions to read sensor values
uint8_t poll_pH() {
    data[0] = analogRead(36);  // Simulated pH value
    return 1;
}
uint8_t poll_TDS() {
    data[2] = 300;  // Simulated TDS value
    return 1;
}
uint8_t poll_Turbidity() {
    data[1] = analogRead(33);   // Simulated Turbidity value
    return 1;
}

// Function to initialize all sensors
void setupSensors() {
    for (int i = 0; i < N_SENSORS; i++) {
        sensors[i].status = sensors[i].init_sensor();
        if (!sensors[i].status) {
            Serial.printf("%s sensor initialization failed.\n", sensors[i].name);
        } else {
            Serial.printf("%s sensor initialized successfully.\n", sensors[i].name);
        }
    }
}

// Function to run inference
void runInference() {
    Serial.println("\nStarting inferencing...");
    
    // Check available heap memory
    Serial.printf("Free Heap: %d bytes\n", ESP.getFreeHeap());

    // Allocate buffer in PSRAM if available
    float *buffer = (float*) heap_caps_malloc(EI_CLASSIFIER_DSP_INPUT_FRAME_SIZE * sizeof(float), MALLOC_CAP_SPIRAM);
    if (!buffer) {
        Serial.println("PSRAM allocation failed! Falling back to internal RAM.");
        buffer = (float*) malloc(EI_CLASSIFIER_DSP_INPUT_FRAME_SIZE * sizeof(float));
        if (!buffer) {
            Serial.println("Memory allocation failed! Skipping inference.");
            return;
        }
    }

    // Sampling process
    Serial.println("Buffer filled with sensor data:");
    for (size_t ix = 0; ix < EI_CLASSIFIER_DSP_INPUT_FRAME_SIZE; ix += N_SENSORS) {
        for (int i = 0; i < N_SENSORS; i++) {
            sensors[i].poll_sensor();
            buffer[ix + i] = *sensors[i].value;
            Serial.printf("%.2f ", buffer[ix + i]);
        }
    }
    Serial.println();

    // Run inference
    signal_t signal;
    int err = numpy::signal_from_buffer(buffer, EI_CLASSIFIER_DSP_INPUT_FRAME_SIZE, &signal);
    if (err != 0) {
        Serial.printf("Signal error: %d\n", err);
        free(buffer);
        return;
    }

    ei_impulse_result_t result;
    err = run_classifier(&signal, &result, false);
    if (err != EI_IMPULSE_OK) {
        Serial.printf("Classifier error: %d\n", err);
        free(buffer);
        return;
    }

    // Print inference results
    Serial.println("\nInference Results:");
    for (size_t ix = 0; ix < EI_CLASSIFIER_LABEL_COUNT; ix++) {
        Serial.printf("%s: %.5f\n", result.classification[ix].label, result.classification[ix].value);
    }
  float greatest = result.classification[0].value;
  const char* label = result.classification[0].label;
  if(result.classification[1].value>greatest)
  {
    greatest =     result.classification[1].value;
    label = result.classification[1].label;
  }
  if(result.classification[2].value>greatest)
  {
    greatest = result.classification[2].value;
    label = result.classification[2].label;
  }    

  if(label == "goodwater")
  {
  display.clearDisplay();
  display.setCursor(20, 0);
  display.println("WATER QUALITY");
  display.setCursor(20, 30);
  display.println("GOOD WATER");
  display.drawBitmap(0, 0, good, 128, 64, WHITE);
  }
  if(label == "badwater")
  {
  display.clearDisplay();
  display.setTextSize(1);
  display.setCursor(20, 0);
  display.println("WATER QUALITY");
  display.setCursor(20, 30);
  display.println("BAD WATER");
  display.drawBitmap(0, 0, bad, 128, 64, WHITE);
  }
  if(label == "nowater")
  {
  display.clearDisplay();
  display.setTextSize(1);
  display.setCursor(20, 0);
  display.println("WATER QUALITY");
  display.setCursor(20, 30);
  display.println("NO WATER");
  display.drawBitmap(0, 0, no, 128, 64, WHITE);
  } 
  display.display();  // Update display
  free(buffer); // Free allocated memory
}

// FreeRTOS Task for inference
void inferenceTask(void *pvParameters) {
    setupSensors(); // Initialize sensors
    while (1) {
        runInference();
        vTaskDelay(2000 / portTICK_PERIOD_MS); // Delay before next inference
    }
}

// Setup function
void setup() {
    Serial.begin(115200);
    while (!Serial);

    Serial.println("Edge Impulse Water Quality Monitoring");

    Serial.printf("Model Info: %d input frame size, %d classes\n",
                  EI_CLASSIFIER_DSP_INPUT_FRAME_SIZE, EI_CLASSIFIER_LABEL_COUNT);
  // Initialize OLED display
  if (!display.begin(SSD1306_SWITCHCAPVCC, 0x3C)) {  // 0x3C is the I2C address
    Serial.println(F("SSD1306 allocation failed"));
    for (;;);
  }
    xTaskCreatePinnedToCore(
        inferenceTask,  // Task function
        "Inference",    // Task name
        STACK_SIZE,     // Stack size (16KB)
        NULL,           // Parameters
        1,              // Priority
        NULL,           // Task handle
        1               // Run on core 1
    );
  display.clearDisplay();
  display.drawBitmap(0, 0, logo, 128, 64, WHITE);
  display.setTextColor(WHITE);
  display.display();  
  delay(5000);
}

// Empty loop (inference runs in a separate task)
void loop() {
}
